## configs/algiz_defconfig
```kconfig
CONFIG_COMPRESS_GZIP=y
CONFIG_SIMPLE_FB=y
CONFIG_MT6877=y
CONFIG_VOLLA_ALGIZ=y
CONFIG_TEXT_BASE=0x40080000
CONFIG_PAYLOAD_ENTRY=0x60000000
CONFIG_RAMDISK_ENTRY=0x51100000
```
